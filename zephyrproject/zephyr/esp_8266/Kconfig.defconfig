## zephyrproject/zephyr/esp_8266/Kconfig.defconfig
```kconfig
# Copyright (c) 2020 Gerson Fernando Budke <nandojve@gmail.com>
# SPDX-License-Identifier: Apache-2.0

if SHIELD_ESP_8266

if NETWORKING

config WIFI_ESP
	default y
	depends on WIFI

rsource "boards/*.defconfig"

endif # NETWORKING

endif # SHIELD_ESP_8266
```
